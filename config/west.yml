## config/west.yml
```yaml
manifest:
  remotes:
    - name: zmkfirmware
      url-base: https://github.com/zmkfirmware
    - name: m165437                # ⟵ AJOUT
      url-base: https://github.com/M165437   # ⟵ AJOUT

  projects:
    - name: eyelash_sofle
      url: https://github.com/a741725193/zmk-sofle
      revision: main
    - name: zmk
      remote: zmkfirmware
      revision: v0.3.0
      import: app/west.yml

    - name: nice-view-gem          # ⟵ AJOUT
      remote: m165437              # ⟵ AJOUT
      revision: main               # ⟵ AJOUT

  self:
    path: boards
```
